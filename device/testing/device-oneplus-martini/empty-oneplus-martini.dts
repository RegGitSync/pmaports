/dts-v1/;
/plugin/;

/ {
	model = "Qualcomm Technologies, Inc. Lahaina MTP martini";
	compatible = "qcom,lahaina-mtp", "qcom,lahaina", "qcom,mtp";
	qcom,board-id = <0x10008 0>;
	oem,project-id = <0x20820 0x20821>;
	oem,project-codename = "martini";
	oem,hw-id = <11 12 13 21 22 23 31 32 33>;
};

&apps_rsc {
	compatible = "qcom,rpmh-rsc";
};
